## board/adlink/lec-imx8mp/Kconfig
```kconfig
if TARGET_LEC_IMX8MP

config SYS_BOARD
	default "lec-imx8mp"

config SYS_VENDOR
	default "adlink"

config SYS_CONFIG_NAME
	default "lec-imx8mp"

config IMX_CONFIG
	default "board/adlink/lec-imx8mp/imximage-8mp-lpddr4.cfg"

config IMX_DDRSIZE
	bool "Define lec-imx8mp DDR Size"
	depends on TARGET_LEC_IMX8MP

choice
	prompt "Select a lec-imx8mp DDR Size"
	depends on IMX_DDRSIZE

	config LPDDR4_2GB
		bool "LPDDR4_2GB"

        config LPDDR4_2GK
		bool "LPDDR4_2GK"

	config LPDDR4_4GB
		bool "LPDDR4_4GB"

	config LPDDR4_8GB
		bool "LPDDR4_8GB"

endchoice

endif
```

## configs/sr_cn913x_cex7_defconfig
```kconfig
# # CONFIG_CMD_FLASH is not set
# # CONFIG_CMD_SETEXPR is not set
# # CONFIG_DISPLAY_CPUINFO is not set
# # CONFIG_SYS_CONSOLE_INFO_QUIET is not set
# # CONFIG_SYS_MALLOC_CLEAR_ON_INIT is not set
# #CONFIG_MVEBU_BOOT_DEVICE=1
# #CONFIG_MVEBU_BOOT_PART=0
# CONFIG_AHCI=y
# CONFIG_AHCI_MVEBU=y
# CONFIG_ARCH_CPU_INIT=y
# CONFIG_ARCH_EARLY_INIT_R=y
# CONFIG_ARCH_MVEBU=y
# CONFIG_ARM=y
# CONFIG_BOARD_EARLY_INIT_F=y
# CONFIG_CMD_CACHE=y
# CONFIG_CMD_EXT4_WRITE=y
# CONFIG_CMD_GPIO=y
# CONFIG_CMD_I2C=y
# CONFIG_CMD_MMC=y
# CONFIG_CMD_MTD=y
# CONFIG_CMD_MTDPARTS=y
# CONFIG_CMD_MVEBU_BUBT=y
# CONFIG_CMD_MVEBU_HW_INFO=y
# CONFIG_CMD_MVEBU_RX_TRAINING=y
# CONFIG_CMD_MVEBU_SAR=y
# CONFIG_CMD_PCI=y
# CONFIG_CMD_REGULATOR=y
# CONFIG_CMD_SF=y
# CONFIG_CMD_SPI=y
# CONFIG_CMD_TIME=y
# CONFIG_CMD_TLV_EEPROM=y
# CONFIG_CMD_UBI=y
# CONFIG_CMD_USB=y
# CONFIG_CUSTOM_SYS_INIT_SP_ADDR=0xff0000
# CONFIG_DEBUG_UART=y
# CONFIG_DEBUG_UART_ANNOUNCE=y
# CONFIG_DEBUG_UART_BASE=0xf0512000
# CONFIG_DEBUG_UART_CLOCK=200000000
# CONFIG_DEBUG_UART_SHIFT=2
# CONFIG_DISTRO_DEFAULTS=y
# CONFIG_DM_GPIO=y
# CONFIG_DM_I2C=y
# CONFIG_DM_MMC=y
# CONFIG_DM_PCA953X=y
# CONFIG_DM_PCI=y
# CONFIG_DM_REGULATOR_FIXED=y
# CONFIG_DM_REGULATOR_GPIO=y
# CONFIG_DM_RTC=y
# CONFIG_DM_THERMAL=y
# CONFIG_DM_USB=y
# CONFIG_E1000=y
# CONFIG_ENV_IS_IN_MMC=y
CONFIG_ENV_OFFSET=0x3f0000
# CONFIG_ENV_SECT_SIZE=0x10000
# CONFIG_ENV_SIZE=0x10000
# CONFIG_HAS_CUSTOM_SYS_INIT_SP_ADDR=y
# CONFIG_I2C_EEPROM=y
# CONFIG_KIRKWOOD_SPI=y
# CONFIG_MAC_PARTITION=y
# CONFIG_MISC=y
# CONFIG_MMC_BROKEN_CD=y
# CONFIG_MMC_HS400_SUPPORT=y
# CONFIG_MMC_IO_VOLTAGE=y
# CONFIG_MMC_SDHCI=y
# CONFIG_MMC_SDHCI_XENON=y
# CONFIG_MMC_UHS_SUPPORT=y
# CONFIG_MTD=y
# CONFIG_MVEBU_COMPHY_SUPPORT=y
# CONFIG_MVEBU_EFUSE=y
# CONFIG_MVEBU_MMC_BOOT=y
# CONFIG_MVEBU_SAR=y
# CONFIG_MVPP2=y
# CONFIG_NAND=y
# CONFIG_NAND_PXA3XX=y
# CONFIG_NR_DRAM_BANKS=2
# CONFIG_NVME_PCI=y
# CONFIG_PCI=y
# CONFIG_PCIE_DW_MVEBU=y
# CONFIG_PHY_GIGE=y
# CONFIG_PHY_MARVELL=y
# CONFIG_PINCTRL=y
# CONFIG_PINCTRL_ARMADA_8K=y
# CONFIG_SMBIOS_MANUFACTURER=""
# CONFIG_SMBIOS_PRODUCT_NAME=""
# CONFIG_SPI_FLASH=y
# CONFIG_SPI_FLASH_MACRONIX=y
# CONFIG_SPI_FLASH_MTD=y
# CONFIG_SPI_FLASH_SPANSION=y
# CONFIG_SPI_FLASH_STMICRO=y
# CONFIG_SPI_FLASH_WINBOND=y
# CONFIG_SUPPORT_EMMC_BOOT=y
# CONFIG_SYS_BOOTM_LEN=0x800000
# CONFIG_SYS_CONSOLE_ENV_OVERWRITE=y
# CONFIG_SYS_I2C_MVTWSI=y
# CONFIG_SYS_LOAD_ADDR=0x800000
# CONFIG_SYS_MALLOC_F_LEN=0x2000
# CONFIG_SYS_NS16550=y
# CONFIG_SYS_PBSIZE=1051
# CONFIG_SYS_PROMPT="Marvell>> "
# CONFIG_SYS_RELOC_GD_ENV_ADDR=y
# CONFIG_SYS_TEXT_BASE=0x00000000
# CONFIG_TARGET_OCTEONTX2_CN913x=y
# CONFIG_TEXT_BASE=0x00000000
# CONFIG_USB=y
# CONFIG_USB_EHCI_HCD=y
# CONFIG_USB_ETHER_ASIX=y
# CONFIG_USB_ETHER_MCS7830=y
# CONFIG_USB_ETHER_RTL8152=y
# CONFIG_USB_ETHER_SMSC95XX=y
# CONFIG_USB_HOST_ETHER=y
# CONFIG_USB_XHCI_HCD=y
# CONFIG_USE_PREBOOT=y
# CONFIG_NET_RANDOM_ETHADDR=y


# CONFIG_CMD_FLASH is not set
# CONFIG_CMD_SETEXPR is not set
# CONFIG_DISPLAY_CPUINFO is not set
# CONFIG_SYS_MALLOC_CLEAR_ON_INIT is not set
#CONFIG_MVEBU_BOOT_DEVICE=1
#CONFIG_MVEBU_BOOT_PART=0
CONFIG_AHCI=y
CONFIG_AHCI_MVEBU=y
CONFIG_ARCH_EARLY_INIT_R=y
CONFIG_ARCH_MISC_INIT=y
CONFIG_ARCH_MVEBU=y
CONFIG_ARM=y
CONFIG_BOARD_EARLY_INIT_F=y
CONFIG_CMD_CACHE=y
CONFIG_CMD_EXT4_WRITE=y
CONFIG_CMD_FUSE=y
CONFIG_CMD_GPIO=y
CONFIG_CMD_I2C=y
CONFIG_CMD_MMC=y
CONFIG_CMD_MTD=y
CONFIG_CMD_MTDPARTS=y
CONFIG_CMD_MVEBU_BUBT=y
CONFIG_CMD_MVEBU_HW_INFO=y
CONFIG_CMD_MVEBU_PHY_FW_DOWNLOAD=y
CONFIG_CMD_MVEBU_RX_TRAINING=y
CONFIG_CMD_MVEBU_SAR=y
CONFIG_CMD_PCI=y
CONFIG_CMD_REGULATOR=y
CONFIG_CMD_SF=y
CONFIG_CMD_SPI=y
CONFIG_CMD_TIME=y
CONFIG_CMD_TLV_EEPROM=y
CONFIG_CMD_UBI=y
CONFIG_CMD_USB=y
CONFIG_DEBUG_UART=y
CONFIG_DEBUG_UART_ANNOUNCE=y
CONFIG_DEBUG_UART_BASE=0xf0512000
CONFIG_DEBUG_UART_CLOCK=200000000
CONFIG_DEBUG_UART_SHIFT=2
CONFIG_DISTRO_DEFAULTS=y
CONFIG_DM_GPIO=y
CONFIG_DM_I2C=y
CONFIG_DM_MMC=y
CONFIG_DM_PCA953X=y
CONFIG_DM_PCI=y
CONFIG_DM_REGULATOR_FIXED=y
CONFIG_DM_REGULATOR_GPIO=y
CONFIG_DM_RTC=y
CONFIG_DM_THERMAL=y
CONFIG_DM_USB=y
CONFIG_E1000=y
CONFIG_ENV_IS_IN_MMC=y
CONFIG_I2C_EEPROM=y
CONFIG_KIRKWOOD_SPI=y
CONFIG_MAC_PARTITION=y
CONFIG_MARVELL_RTC=y
CONFIG_MISC=y
CONFIG_MMC_BROKEN_CD=y
CONFIG_MMC_HS400_SUPPORT=y
CONFIG_MMC_IO_VOLTAGE=y
CONFIG_MMC_SDHCI=y
CONFIG_MMC_SDHCI_XENON=y
CONFIG_MMC_UHS_SUPPORT=y
CONFIG_MTD=y
CONFIG_MVEBU_COMPHY_SUPPORT=y
CONFIG_MVEBU_EFUSE=y
CONFIG_MVEBU_EFUSE_READ_ONLY=y
CONFIG_MVEBU_MMC_BOOT=y
CONFIG_MVEBU_SAR=y
CONFIG_MVEBU_THERMAL_EXT_SENSOR_28NM=y
CONFIG_MVEBU_THERMAL_SENSOR_28NM=y
CONFIG_MVPP2=y
CONFIG_NAND=y
CONFIG_NAND_PXA3XX=y
CONFIG_OF_BOARD_FIXUP=y
CONFIG_PCI=y
CONFIG_PCIE_DW_MVEBU=y
CONFIG_PHY_GIGE=y
CONFIG_PHY_MARVELL=y
CONFIG_PINCTRL=y
CONFIG_PINCTRL_ARMADA_8K=y
CONFIG_SMBIOS_MANUFACTURER=""
CONFIG_SMBIOS_PRODUCT_NAME=""
CONFIG_SPI_FLASH=y
CONFIG_SPI_FLASH_MACRONIX=y
CONFIG_SPI_FLASH_MTD=y
CONFIG_SPI_FLASH_SPANSION=y
CONFIG_SPI_FLASH_STMICRO=y
CONFIG_SPI_FLASH_WINBOND=y
CONFIG_SYS_CONSOLE_ENV_OVERWRITE=y
CONFIG_SYS_CONSOLE_INFO_QUIET=y
CONFIG_SYS_I2C_MVTWSI=y
CONFIG_SYS_MALLOC_F_LEN=0x2000
CONFIG_SYS_NS16550=y
CONFIG_SYS_PROMPT="Marvell>> "
CONFIG_SYS_TEXT_BASE=0x00000000
CONFIG_TARGET_OCTEONTX2_CN913x=y
CONFIG_USB=y
CONFIG_USB_EHCI_HCD=y
CONFIG_USB_ETHER_ASIX=y
CONFIG_USB_ETHER_MCS7830=y
CONFIG_USB_ETHER_RTL8152=y
CONFIG_USB_ETHER_SMSC95XX=y
CONFIG_USB_HOST_ETHER=y
CONFIG_USB_XHCI_HCD=y
CONFIG_SUPPORT_EMMC_BOOT=y
CONFIG_NET_RANDOM_ETHADDR=y
CONFIG_LAST_STAGE_INIT=y
```

## lib/tlv/Kconfig
```kconfig
config EEPROM_TLV_LIB
	bool "Support EEPROM TLV library"
	depends on I2C_EEPROM
	help
	  Selecting this option will enable the shared EEPROM TLV library code.
```
